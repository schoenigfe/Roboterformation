## components/DataLogger/Kconfig.projbuild
```kconfig
menu "Data Logger"

    config DATA_LOG_SAMPLE_SIZE
        int "log sample size"
        default 64
        help
            Maximum log sample size per call to macro LOG_DATA().
            Big values will lead to wasted heap memory.
            Adjust value according to your maximum log sample.

    config DATA_LOG_BUFFER_SIZE
        int "log buffer size"
        default 2048
        help
            Size of each heap buffer, which stores the data logs.
            Small values will lead to many heap allocations.

    config DATA_LOG_QUEUE_SIZE
        int "log queue size"
        default 32
        help
            Maximum size of FreeRTOS queue.
            Check available dynamic memory for calculating this value.
    
    config MAX_LOG_TIME_SECONDS
        int "maximum logging time in seconds"
        default 120
        help
            Maximum logging time in seconds.

endmenu
```

## components/Imu/Kconfig.projbuild
```kconfig
menu "I2C Configuration"
    config I2C_MASTER_SCL
        int "SCL GPIO Num"
        default 19
        help
            GPIO number for I2C Master clock line.

    config I2C_MASTER_SDA
        int "SDA GPIO Num"
        default 18
        help
            GPIO number for I2C Master data line.
endmenu
```

## components/LedStrip/Kconfig.projbuild
```kconfig
menu "LED Strip Configuration"
    config LED_RMT_TX_GPIO
        int "LED TX GPIO"
        default 25
        help
            Set the GPIO number used for transmitting the RMT signal.

    config LED_STRIP_LED_NUMBER
        int "Number of LEDS in a strip"
        default 43
        help
            A single RGB strip contains several LEDs.
endmenu
```

## components/MotorController/Kconfig.projbuild
```kconfig
menu "Motor Configuration"

    config MOTOR_A_IN1
        int "Motor A IN1"
        default "21"
    config MOTOR_A_IN2
        int "Motor A IN2"
        default "22"
    
    config MOTOR_A_INCREMENTAL_ENCODER_1
        int "Motor A incremental encoder 1"
        default "34"

    config MOTOR_A_INCREMENTAL_ENCODER_2
        int "Motor A incremental encoder 2"
        default "35"
    
    config MOTOR_B_IN1
        int "Motor B IN1"
        default "19"
    config MOTOR_B_IN2
        int "Motor B IN2"
        default "18"

    config ENABLE_PIN
        int "Enable Pin"
        default "23"
    
    config MOTOR_B_INCREMENTAL_ENCODER_1
        int "Motor B incremental encoder 1"
        default "36"
    config MOTOR_B_INCREMENTAL_ENCODER_2
        int "Motor B incremental encoder 2"
        default "39"
            
    
    config MOTOR_PWM_FREQUENCY
        int "PWM_FEQUENCY"
        default "20000"
        help
            Define the Pwm frequency.

endmenu
```

## components/SensorPose/Kconfig.projbuild
```kconfig
menu "Marvelmind"

    config UART_TX_PIN
        int "Uart Tx Pin"
        default "27"

    config UART_RX_PIN
        int "Uart Rx Pin"
        default "26"

    config UART_BAUDRATE
        int "Uart Baudrate"
        default 115200

    config UART_RX_BUFFER
        int "Uart Rx Buffer"
        default 512
endmenu
```

## main/Kconfig.projbuild
```kconfig
menu "Socket Configuration"

    config SERVER_IP_ADDR
        string "Server IP address"
        default "0.0.0.0"
        help
            The client will connect to this IPV4 address.

    config ROS_SOCKET_PORT
        int "Socket Port"
        range 0 65535
        default 2888
        help
            Port for tcp/udp socket communication

endmenu
```
